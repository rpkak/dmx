/dts-v1/;
/plugin/;
/ {
	compatible = "raspberrypi,4-model-b";
	fragment@0 {
		target-path = "/";
		__overlay__ {
			dmx {
				compatible = "gpio-dmx";
				dmx-gpio = <&gpio 23 0>;
				clk-gpio = <&gpio 3 0>;
			};
		};
	};
};
